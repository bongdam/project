## dvw2700/cpkg/user/Kconfig
```kconfig
menu "Davolink custom package(cpkg) for user mode"

config LIB_YTOOL
	bool "libytool"
	default y
	help
	  Library contains APIs which have been used often and generally.
	  This is the default implementation choice.  Must choose this one unless
	  you have a good reason not to.

config LIB_NVRAM
	bool "nvram"
	default y
	help
	  This option depends on NVRAM device in Linux kernel.
	  This library is the half part of NVRAM in user mode.

config LIB_SHARED
	bool "libshared"
	default y
	help
	  Library contains miscellaneous funtions including shell-like utility ones.
	  This option is intended for importing applications based on broadcom SDK.

config LIB_SELECT_EVENT
	bool "libselect_event"
	default y
	help
	  Library is aimed at providing framework to manage multiple file descriptors
	  which can be monitored by select system call.

config LIB_CAPTCHA
	bool "libcaptcha"
	default y
	help
	  Generating a  Captcha image

config NVRAM_APMIB
	bool "nvram_mib"
	depends on LIB_NVRAM && LIB_YTOOL
	default y
	help
	  This option changes APMIB - Realek proprietary configuration subsystem
	  into nvram of Broadcom. APMIB library api should be rewritten to work
	  on nvram.

config NVRAM_APMIB_HIST
	bool "nvram_mib_history"
	depends on NVRAM_APMIB
	default n
	help
	  This option records nvram manipulation history.

config DVBOX
	bool "dvbox"
	default y
	help
	  A suite of applets having specific purpose.

config LIB_FURL
	bool "furl"
	depends on !APP_FWD
	default y
	help
	  This library includes implementations needed to verify, burn and dualize
	  firmware image.

config MPSTAT
	bool "mpstat"
	default y
	help
	   Per-processor statistics.

config ACLWRITE
	bool "aclwrite"
	default y
	help
	   Manipulate hardware ACL table.

config APP_WLCMD
	bool "wlcmd"
	default n
	help
	  wl command like broadcom

config LIB_CAPTCHA
	bool "captcha"
	default y
	help
	  check to login validate.

config APP_LABORER
	bool "laborer"
	default y
	help
	  House keeping daemon process.

config LABORER_JOB_RELOAD
	bool "reload job by laborer"
	depends on APP_LABORER && !APP_RELOAD
	default y
	help
	  Monitor and restoring to default by laborer

config TELNET
	bool "telnetd"
	default y
	help
	  add telnet.

config UDHCPD
	bool "udhcp"
	depends on !APP_UDHCPD
	default y
	help
	  An embedded DHCP client and server.

config TMS
	bool "tms"
	default y
	help
	  provision client.

config APP_DVQOS
	bool "dvqos"
	default y
	help
	  control qos of wire.

config LIB_KCRYPTO_API
	bool "libkcapi"
	default n
	help
	  Userspace crypto API utilizing kernel crypto engine

config LIB_NETFILTER
	bool "libnetfilter"
	default n
	help
	  Collection of userspace library to interwork kernel's netfilter

config LABORER_JOB_WEBRD
	bool "redirect web by laborer"
	depends on APP_LABORER
	default y
	help
	  Redirect outgoing http request into notifying failure

config SNMP
	bool "snmp"
	default y
	help
	  Simple Network Management Protocol.

endmenu
```

## dvw2700/linux-3.10/drivers/cpkg/Kconfig
```kconfig
#
# Davolink Custom Package Configuration
#
# 2018-10-18 young
#

menu "Davolink custom package(cpkg) devices"

config BCMNVRAM
	bool "Broadcom nvram device support"

config BRDIO
	bool "Board specific helper"
	default y

config DVFLAG
	bool "Notification of bitwised system event"
	default y

config GPIO_BUTTON_FSM
	bool "Execute finite state machine with gpio button or switch"
	depends on BRDIO && DVFLAG
	default y

config NF_NAT_TWINIP
	bool "Twin ip support, also known as Super-DMZ"
	default y
	help
	  A host could have the same IPv4 address of an address
	  configured with WAN interface.

	  If unsure, say N.

endmenu
```

## h624g/Kconfig
```kconfig
mainmenu "RLX Linux Configuration"

comment "select components"
choice
	prompt "Selected Target"
config BOARD_rtl8198C_8954E
	bool "rtl8198C_8954E"
config BOARD_rtl819xD
	bool "rtl819xD"
config BOARD_rtl89xxE
	bool "rtl89xxE"
endchoice

config BOARDDIR
	string

##############################################################


choice
	prompt "Selected Kernel"
	default LINUX_3.10

config LINUX_3.10
	bool "linux-3.10"

endchoice

config LINUXDIR
	string

choice
	prompt "Selected Busybox"
config BZBOX_busybox-1.13
	bool "busybox-1.13"
endchoice

config BZBOXDIR
	string

if BOARD_rtl8196e||BOARD_rtl8196eu
choice
	prompt "Selected toolchain"
config RSDK_rsdk-1.5.5-4181-EB-2.6.30-0.9.30.3-110225
	bool "rsdk-1.5.5-4181-EB-2.6.30-0.9.30.3-110225"
config RSDK_rsdk-4.4.7-4181-EB-2.6.30-0.9.30-m32u-140129
	bool "rsdk-4.4.7-4181-EB-2.6.30-0.9.30-m32u-140129"
endchoice
endif
if  !BOARD_rtl8196e && !BOARD_rtl8196eu 
choice
  prompt "Selected toolchain"
config RSDK_msdk-4.4.7-mips-EB-3.10-0.9.33-m32t-131227b
	bool "msdk-4.4.7-mips-EB-3.10-0.9.33-m32t-131227b"
endchoice
endif

config RSDKDIR
	string

if BOARD_rtl8198C_8954E
	source "boards/rtl8198C_8954E/board-configuration.in"
endif
if BOARD_rtl819xD
  if LINUX_3.10
    source "boards/rtl819xD/board-configuration-3.10.in"
  endif
  if LINUX_2.6.30
    source "boards/rtl819xD/board-configuration.in"
  endif
endif
if BOARD_rtl89xxE
	source "boards/rtl89xxE/board-configuration.in"
endif
##############################################################

comment "config components"
config MCONF_LINUX
	bool "Config kernel"

config MCONF_USERS
	bool "Config users"
config MCONF_BZBOX
	bool "Config busybox"
config MCONF_LOAD
	bool "Load default settings"

config MCONF_SAVE
	bool "Save default settings"
```

## h624g/cpkg/user/Kconfig
```kconfig
menu "Davolink custom package(cpkg) for user mode"

config LIB_YTOOL
	bool "libytool"
	default y
	help
	  Library contains APIs which have been used often and generally.
	  This is the default implementation choice.  Must choose this one unless
	  you have a good reason not to.

config LIB_NVRAM
	bool "nvram"
	default y
	help
	  This option depends on NVRAM device in Linux kernel.
	  This library is the half part of NVRAM in user mode.

config LIB_SHARED
	bool "libshared"
	default y
	help
	  Library containis miscellaneous funtions including shell-like utility ones.
	  This option is intended for importing applications based on broadcom SDK.

config APP_RC
	bool "rc"
	default n
	help
	  Router control(rc) script has fast, light and efficient implementation to
	  manage routing services.
	  This option requires that init implementation of busybox should be
	  disabled.

config UDHCP_SKB
	bool "udhcp"
	depends on !APP_UDHCPD
	default y
	help
	  An embedded DHCP client and server.

config APP_ARPROBE
	bool "arprobe"
	default y
	help
	  IP conflict check.

config APP_RTNETLNK
	bool "rtnetlnk"
	default y
	help
	  bound check.

config APP_MINIUPNPD
	bool "miniupnpd-1.9"
	default y
	help
	  add miniupnpd.

config NVRAM_APMIB
	bool "nvram_mib"
	depends on LIB_NVRAM && LIB_YTOOL
	default y
	help
	  This option changes APMIB - Realek proprietary configuration subsystem
	  into nvram of Broadcom. APMIB library api should be rewritten to work
	  on nvram.

config APP_HOLEPUNCH
	bool "holepunch"
	default y
	help
	  Holepunch Service.

config APP_AUTO_REBOOT
	bool "auto_reboot"
	default y
	help
	  Auto_Reboot Service.

config DVBOX
	bool "dvbox"
	default y
	help
	  A suite of applets having specific purpose.

config LIB_FURL
	bool "furl"
	default y
	help
	  This library includes implementations needed to verify, burn and dualize
	  firmware image.

config ARES
	bool "ares"
	default y
	help
	  asynchronous DNS requests.

config MPSTAT
	bool "mpstat"
	default y
	help
	   Per-processor statistics.

config ACLWRITE
	bool "aclwrite"
	default y
	help
	   Manipulate hardware ACL table.

config TELNET
	bool "telnetd"
	default y
	help
	   add telnet.

config APP_DVSNMP
	bool "dvsnmp"
	default 'y'
	help
		Symple Network Management Protocol.

config APP_SWMS
	bool "swms"
	default y
	help
	   add swms

config APP_DVQOS
	bool "dvqos"
	default y
	help
	   control qos of wire.

config APP_IGMPQUERIER
	bool "igmp_querier"
	default y
	help
	   control igmp querier.

config APP_ARPDEFENDER
	bool "arp_defender"
	default y
	help
	   arp spoofing defender.

config APP_LDAP
	bool "ldap"
	default y
	help
	  AP CFG Service

config APP_WLCMD
	bool "wlcmd"
	default n
	help
	  wl command like broadcom

config LIB_CAPTCHA
	bool "captcha"
	default y
	help
	  check to login validate.

config APP_CHILD_GUARD
	bool "child_guard"
	default y
	help
	  Child_Guard Service

endmenu
```

## h624g/linux-3.10/drivers/cpkg/Kconfig
```kconfig
#
# Davolink Custom Package Configuration
#
# 2015-03-24 20:48:26 young
#

menu "Davolink custom package(cpkg) devices"

config BCMNVRAM
	bool "Broadcom nvram device support"

config NF_NAT_BATTLENET
	bool "ALG for StartCraft"
	default y

config WLAN0_RX_FREEZE_CRUDE_WORKAROUND
	bool "Workaround for 5G's rx hang up"
	default y
	help
	  Workaround to overcome rx hang up of 5G wifi which is likely to happen immediately
	  after boot up.

	  If unsure, say N.

endmenu
```

## p201/cpkg/user/Kconfig
```kconfig
menu "Davolink custom package(cpkg) for user mode"

config LIB_YTOOL
	bool "libytool"
	default y
	help
	  Library contains APIs which have been used often and generally.
	  This is the default implementation choice.  Must choose this one unless
	  you have a good reason not to.

config LIB_NVRAM
	bool "nvram"
	default y
	help
	  This option depends on NVRAM device in Linux kernel.
	  This library is the half part of NVRAM in user mode.

config LIB_SHARED
	bool "libshared"
	default y
	help
	  Library contains miscellaneous funtions including shell-like utility ones.
	  This option is intended for importing applications based on broadcom SDK.

config LIB_SELECT_EVENT
	bool "libselect_event"
	default y
	help
	  Library is aimed at providing framework to manage multiple file descriptors
	  which can be monitored by select system call.

config LIB_KCRYPTO_API
	bool "libkcapi"
	default n
	help
	  Userspace crypto API utilizing kernel crypto engine

config LIB_NETFILTER
	bool "libnetfilter"
	default n
	help
	  Collection of userspace library to interwork kernel's netfilter

config NVRAM_APMIB
	bool "nvram_mib"
	depends on LIB_NVRAM && LIB_YTOOL
	default y
	help
	  This option changes APMIB - Realek proprietary configuration subsystem
	  into nvram of Broadcom. APMIB library api should be rewritten to work
	  on nvram.

config DVBOX
	bool "dvbox"
	default y
	help
	  A suite of applets having specific purpose.

config APP_LABORER
	bool "laborer"
	default y
	help
	  House keeping daemon process.

config LIB_FURL
	bool "furl"
	depends on !APP_FWD
	default y
	help
	  This library includes implementations needed to verify, burn and dualize
	  firmware image.

config LIB_SSL
	bool "libssl"
	default n
	help
	  OpenSSL is a robust, commercial-grade, and full-featured toolkit for the
	  Transport Layer Security (TLS) and Secure Sockets Layer (SSL) protocols.
	  It is also a general-purpose cryptography library.

config SEC_CONTAINER
	bool "secure-container"
	default n
	help
	  This utility can contain any arbitrary data securely.

config ACLWRITE
	bool "aclwrite"
	default y
	help
	  Manipulate hardware ACL table.

config LIB_CURL_NEW
	bool "curl"
	default n
	help
	  Curl is command line tool and library for transferring data with URLs.

config APP_VPN_SERVER
	bool "vpnserver"
	default n
	help
	  IPSec, PPTP and L2TP VPN client/server

config LIB_EXPAT_XML
	bool "XML parser library"
	default n
	help
	  XML parser library written in C. It is a stream-oriented parser
	  in which an application registers handlers for things the parser
	  might find in the XML document.

config LIB_GSOAP
	bool "gSOAP toolkit"
	default n
	help
	  The gSOAP toolkit is an extensive suite of portable C and C++
	  software to develop XML Web services with powerful type-safe
	  XML data bindings.

config APP_CWMPCLIENT
	bool "CWMP client"
	depends on LIB_GSOAP
	default n
	help
	  CWMP is a text based protocol. Orders sent between the device(CPE)
	  and auto configuration server (ACS) are transported over HTTPS.

config APP_MINIUPNPD
	bool "miniupnpd-1.9"
	default y
	help
	  add miniupnpd.

config APP_REBOOT_SCHD
	bool "reboot schedule"
	default y
	help
	  reboot scheduling.

endmenu
```

## p201/linux-3.10/drivers/cpkg/Kconfig
```kconfig
#
# Davolink Custom Package Configuration
#
# 2020-04-23 young
#

menu "Davolink custom package(cpkg) devices"

config BCMNVRAM
	bool "Broadcom nvram device support"

config BRDIO
	bool "Board specific helper"
	default y

config DVFLAG
	bool "Notification of bitwised system event"
	default y

config GPIO_BUTTON_FSM
	bool "Execute finite state machine with gpio button or switch"
	depends on BRDIO && DVFLAG
	default y

endmenu
```
